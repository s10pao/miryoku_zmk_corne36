## config/west.yml
```yaml
manifest:
  defaults:
    revision: v0.3.0
  remotes:
    - name: zmkfirmware
      url-base: https://github.com/zmkfirmware
    # Additional modules containing boards/shields/custom code can be listed here as well
    # See https://docs.zephyrproject.org/3.2.0/develop/west/manifest.html#projects
    - name: urob
      url-base: https://github.com/urob/
    # Custom graphics
    - name: s10pao #m165437
      url-base: https://github.com/s10pao/ #https://github.com/M165437
  projects:
    - name: zmk
      remote: zmkfirmware
      import: app/west.yml
    - name: zmk-helpers
      remote: urob
      import: include
    - name: nice-view-gem
      remote: s10pao #m165437
      revision: v0.3.0_custom #main
  self:
    path: config
```
